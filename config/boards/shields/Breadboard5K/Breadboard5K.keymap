#include <behaviors.dtsi>
#include <dt-bindings/zmk/keys.h>
#include <dt-bindings/zmk/bt.h>

/ {
    keymap {
        compatible = "zmk,keymap";

        default_layer {
            bindings = <
                &mo 1       &kp KP_N1       &kp KP_N2       &kp KP_N3       &bootloader
            >;
        };

        bt_layer {
            bindings = <
                &trans      &kp KP_N4       &bt BT_SEL 0    &bt BT_CLR      &bootloader
            >;
        };
    };
};