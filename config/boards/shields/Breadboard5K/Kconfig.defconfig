## config/boards/shields/Breadboard5K/Kconfig.defconfig
```kconfig
if SHIELD_BREADBOARD5K

config ZMK_KEYBOARD_NAME
    default "Breadboard5K"

endif
```

## config/boards/shields/armadillo1/Kconfig.defconfig
```kconfig
if SHIELD_ARMADILLO1_LEFT

# Name must be less than 16 characters long!
config ZMK_KEYBOARD_NAME
    default "Armadillo1"

config ZMK_SPLIT_ROLE_CENTRAL
    default y

endif

if SHIELD_ARMADILLO1_LEFT || SHIELD_ARMADILLO1_RIGHT

config ZMK_SPLIT
    default y

CONFIG_BT_CTLR_TX_PWR_PLUS_8=y
CONFIG_ZMK_BLE_EXPERIMENTAL_CONN=y

endif
```

## config/boards/shields/armadillo1/Kconfig.shield
```kconfig
# No whitespace after the comma or in your part name!
config SHIELD_ARMADILLO1_LEFT
    def_bool $(shields_list_contains,armadillo1_left)

# No whitespace after the comma or in your part name!
config SHIELD_ARMADILLO1_RIGHT
    def_bool $(shields_list_contains,armadillo1_right)
```

## config/boards/shields/breadboard5x5/Kconfig.defconfig
```kconfig
if SHIELD_BREADBOARD5X5

config ZMK_KEYBOARD_NAME
    default "Breadboard5x5"

endif
```
