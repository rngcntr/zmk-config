## config/boards/shields/armadillo_zero/Kconfig.defconfig
```kconfig
if SHIELD_ARMADILLO_ZERO_RIGHT

# Name must be less than 16 characters long!
config ZMK_KEYBOARD_NAME
    default "Armadillo Zero"

config ZMK_SPLIT_ROLE_CENTRAL
    default y

endif

if SHIELD_ARMADILLO_ZERO_LEFT || SHIELD_ARMADILLO_ZERO_RIGHT

config ZMK_SPLIT
    default y

CONFIG_BT_CTLR_TX_PWR_PLUS_8=y
CONFIG_ZMK_BLE_EXPERIMENTAL_CONN=y

config I2C
    default y

config SSD1306
    default y

config LV_Z_BITS_PER_PIXEL
    default 1

choice LV_COLOR_DEPTH
    default LV_COLOR_DEPTH_1
endchoice

endif
```
