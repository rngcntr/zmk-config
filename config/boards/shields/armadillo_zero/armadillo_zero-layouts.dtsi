#include <physical_layouts.dtsi>

/ {
    physical_layout0: physical_layout_0 {
        compatible = "zmk,physical-layout";
        display-name = "Armadillo Zero Default Layout";
        // keys required for zmk studio support
    };
};
